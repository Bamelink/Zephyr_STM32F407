## west.yml
```yaml
manifest:
  self:
    path: asc

  remotes:
    - name: zephyrproject-rtos
      url-base: https://github.com/zephyrproject-rtos

  projects:
    - name: zephyr
      remote: zephyrproject-rtos
      revision: 2ddd73feafd3316af2c547c34d6969bea637d5c6
      import: true
```
